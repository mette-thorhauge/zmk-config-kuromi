## boards/shields/splitpurble/Kconfig.defconfig
```kconfig
if SHIELD_SPLITPURBLE

config ZMK_KEYBOARD_NAME
    default "SplitPurble"

endif
```

## config/boards/shields/kuromi/Kconfig.defconfig
```kconfig
# Copyright (c) 2022 The ZMK Contributors
# SPDX-License-Identifier: MIT

if SHIELD_KUROMI_LEFT

config ZMK_KEYBOARD_NAME
    default "KbKuromi"

config ZMK_SPLIT_ROLE_CENTRAL
    default y

endif

if SHIELD_KUROMI_LEFT || SHIELD_KUROMI_RIGHT

config ZMK_SPLIT
    default y

endif
```

## config/boards/shields/kuromi/Kconfig.shield
```kconfig
# Copyright (c) 2022 The ZMK Contributors
# SPDX-License-Identifier: MIT

config SHIELD_KUROMI_LEFT
    def_bool $(shields_list_contains,kuromi_left)


config SHIELD_KUROMI_RIGHT
    def_bool $(shields_list_contains,kuromi_right)
```

## config/boards/shields/pancake2/Kconfig.defconfig
```kconfig
# Copyright (c) 2022 The ZMK Contributors
# SPDX-License-Identifier: MIT

if SHIELD_PANCAKE2

config ZMK_KEYBOARD_NAME
    default "Pancake2"

endif
```

## config/boards/shields/pancake2/Kconfig.shield
```kconfig
# Copyright (c) 2022 The ZMK Contributors
# SPDX-License-Identifier: MIT

config SHIELD_PANCAKE2_LEFT
    def_bool $(shields_list_contains,pancake2_left)


config SHIELD_PANCAKE2_RIGHT
    def_bool $(shields_list_contains,pancake2_right)
```

## config/boards/shields/splitPurple/Kconfig.defconfig
```kconfig
# Copyright (c) 2022 The ZMK Contributors
# SPDX-License-Identifier: MIT

if SHIELD_SPLITPURBLE_LEFT

config ZMK_KEYBOARD_NAME
    default "KbKuromi"

config ZMK_SPLIT_ROLE_CENTRAL
    default y

endif

if SHIELD_SPLITPURBLE_LEFT || SHIELD_SPLITPURBLE_RIGHT

config ZMK_SPLIT
    default y

endif
```

## config/boards/shields/splitPurple/Kconfig.shield
```kconfig
# Copyright (c) 2022 The ZMK Contributors
# SPDX-License-Identifier: MIT

config SHIELD_SPLITPURBLE_LEFT
    def_bool $(shields_list_contains,splitPurble_left)


config SHIELD_SPLITPURBLE_RIGHT
    def_bool $(shields_list_contains,splitPurble_right)
```

## config/boards/shields/splitpurble/Kconfig.defconfig
```kconfig
if SHIELD_SPLITPURBLE

config ZMK_KEYBOARD_NAME
    defualt "SplitPurble"

endif
```
